## bsps/meta-bakery-bsp/conf/layer.conf
```bitbake
BBPATH .= ":${LAYERDIR}"

BBFILES += "${LAYERDIR}/recipes-*/*/*.bb \
            ${LAYERDIR}/recipes-*/*/*.bbappend"

BBFILE_COLLECTIONS += "meta-bakery-bsp"
BBFILE_PATTERN_meta-bakery-bsp = "^${LAYERDIR}/"
BBFILE_PRIORITY_meta-bakery-bsp = "5"

LAYERDEPENDS_meta-bakery-bsp = "core"
LAYERSERIES_COMPAT_meta-bakery-bsp = "kirkstone scarthgap"
```
